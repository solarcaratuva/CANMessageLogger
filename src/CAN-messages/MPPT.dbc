VERSION ""

NS_ :

BS_:

BU_: MG0 MG1

BO_ 384 MG0Status: 8 MG0
 SG_ MG0InputCurrent : 0|32@1- (1,0) [0|10000] "mA"  MG0
 SG_ MG0InputVoltage : 32|32@1- (1,0) [0|120] "V"  MG0

BO_ 385 MG1Status: 8 MG1
 SG_ MG1InputCurrent : 0|32@1- (1,0) [0|10000] "mA"  MG0
 SG_ MG1InputVoltage : 32|32@1- (1,0) [0|120] "V"  MG0

BO_ 640 MG0OutputVoltageInputPower: 8 MG0
 SG_ MG0OutputVoltage : 0|32@1- (1,0) [0|200] "V"  MG0
 SG_ MG0InputPower : 32|32@1- (1,0) [0|1200000] "mW"  MG0

BO_ 641 MG1OutputVoltageInputPower: 8 MG1
 SG_ MG1OutputVoltage : 0|32@1- (1,0) [0|200] "V"  MG0
 SG_ MG1InputPower : 32|32@1- (1,0) [0|1200000] "mW"  MG0

BO_ 1152 MG0PCBMOSFETTemperature: 4 MG0
 SG_ MG0PCBTemperature : 0|16@1- (0.01,0) [-40|80] "°C"  MG0
 SG_ MG0MOSFETTemperature : 16|16@1- (0.01,0) [-40|80] "°C"  MG0

BO_ 1153 MG1PCBMOSFETTemperature: 4 MG1
 SG_ MG1PCBTemperature : 0|16@1- (0.01,0) [-40|80] "°C"  MG0
 SG_ MG1MOSFETTemperature : 16|16@1- (0.01,0) [-40|80] "°C"  MG0

CM_ BO_ 384 "Current and voltage of the MG0 input";
CM_ SG_ 384 MG0InputCurrent "Current produced by the array connected to MG 0";
CM_ SG_ 384 MG0InputVoltage "Voltage of the array connected to MG0";
CM_ BO_ 385 "Current and voltage of the MG1 input";
CM_ SG_ 385 MG1InputCurrent "Current produced by the array connected to MG 1";
CM_ SG_ 385 MG1InputVoltage "Voltage of the array connected to MG1";
CM_ BO_ 640 "MG0 output voltage and input power";
CM_ SG_ 640 MG0OutputVoltage "Output voltage of MG 0";
CM_ SG_ 640 MG0InputPower "Power produced by the array connected to MG 0";
CM_ BO_ 641 "MG1 output voltage and input power";
CM_ SG_ 641 MG1OutputVoltage "Output voltage of MG 1";
CM_ SG_ 641 MG1InputPower "Power produced by the array connected to MG 1";
CM_ BO_ 1152 "MG0 PCB and MOSFET temperature";
CM_ SG_ 1152 MG0PCBTemperature "Temperature of MG 0's PCB";
CM_ SG_ 1152 MG0MOSFETTemperature "Temperature of MG 0's power MOSFETs";
CM_ BO_ 1153 "MG1 PCB and MOSFET temperature";
CM_ SG_ 1153 MG1PCBTemperature "Temperature of MG 1's PCB";
CM_ SG_ 1153 MG1MOSFETTemperature "Temperature of MG 1's power MOSFETs";
SIG_VALTYPE_ 384 MG0InputCurrent : 1;
SIG_VALTYPE_ 384 MG0InputVoltage : 1;
SIG_VALTYPE_ 385 MG1InputCurrent : 1;
SIG_VALTYPE_ 385 MG1InputVoltage : 1;
SIG_VALTYPE_ 640 MG0OutputVoltage : 1;
SIG_VALTYPE_ 640 MG0InputPower : 1;
SIG_VALTYPE_ 641 MG1OutputVoltage : 1;
SIG_VALTYPE_ 641 MG1InputPower : 1;
